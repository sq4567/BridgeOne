## src/board/BridgeOne/Kconfig.projbuild
```kconfig
# BridgeOne Project Build Configuration
# This file FORCES USB Serial JTAG to be disabled
# because we use USB_PHY_SEL=1 (internal PHY assigned to USB_OTG for TinyUSB)
# without this, the ROM bootloader crashes when trying to initialize USB Serial JTAG

config BRIDGEONE_FORCE_DISABLE_USB_SERIAL_JTAG
    bool
    default y
    help
        BridgeOne requires USB_PHY_SEL=1 in eFuse, which dedicates the internal PHY
        to USB_OTG (for TinyUSB HID/CDC). USB Serial JTAG must be completely disabled
        at the ESP-IDF level to prevent ROM bootloader from attempting initialization.

        This config ensures the following are always disabled:
        - USJ_ENABLE_USB_SERIAL_JTAG
        - ESP_CONSOLE_USB_SERIAL_JTAG_ENABLED
        - ESP_CONSOLE_SECONDARY_USB_SERIAL_JTAG

# Override USB Serial JTAG Enable
config USJ_ENABLE_USB_SERIAL_JTAG
    bool "Enable USB Serial/JTAG Controller"
    default n if BRIDGEONE_FORCE_DISABLE_USB_SERIAL_JTAG
    help
        BridgeOne: Always disabled due to USB_PHY_SEL=1 eFuse configuration.
        The internal PHY is dedicated to USB_OTG for TinyUSB HID/CDC devices.

# Override Console Secondary USB Serial JTAG
config ESP_CONSOLE_SECONDARY_USB_SERIAL_JTAG
    bool "Secondary console output on USB Serial/JTAG Controller"
    default n if BRIDGEONE_FORCE_DISABLE_USB_SERIAL_JTAG
    help
        BridgeOne: Always disabled due to USB_PHY_SEL=1 eFuse configuration.

# Override Console USB Serial JTAG Enable
config ESP_CONSOLE_USB_SERIAL_JTAG_ENABLED
    bool "USB Serial/JTAG is used as console output"
    default n if BRIDGEONE_FORCE_DISABLE_USB_SERIAL_JTAG
    help
        BridgeOne: Always disabled due to USB_PHY_SEL=1 eFuse configuration.
```

## src/board/BridgeOne/components/espressif__tinyusb/Kconfig
```kconfig
menu "TinyUSB Stack"

    config TINYUSB
        bool "Use TinyUSB Stack"
        default n
        help
            Enable TinyUSB stack support for USB device functionality.

    config TINYUSB_DEBUG
        depends on TINYUSB
        int "TinyUSB log level (0-3)"
        default 0
        range 0 3
        help
            Specify TinyUSB stack log level.
            0: No log
            1: Error
            2: Warning
            3: Info

    menu "USB Device Configuration"
        depends on TINYUSB

        config TINYUSB_DEVICE_ENABLED
            bool "Enable USB Device mode"
            default y
            help
                Enable TinyUSB device mode.

        config TINYUSB_DEVICE_BUS_POWERED
            depends on TINYUSB_DEVICE_ENABLED
            bool "Device is bus-powered"
            default y
            help
                Device is powered by USB bus (not self-powered).

        config TINYUSB_DEVICE_SELF_POWERED
            depends on TINYUSB_DEVICE_ENABLED
            bool "Device is self-powered"
            default n
            help
                Device has its own power supply.

        config TINYUSB_DEVICE_MAX_POWER
            depends on TINYUSB_DEVICE_ENABLED
            int "Max power consumption (mA)"
            default 100
            range 0 500
            help
                Maximum power consumption from USB bus in milliamperes.
                USB 2.0 spec allows up to 500mA.

    endmenu # USB Device Configuration

    menu "HID Device Class"
        depends on TINYUSB && TINYUSB_DEVICE_ENABLED

        config TINYUSB_HID_ENABLED
            bool "Enable HID Device Class"
            default n
            help
                Enable USB HID (Human Interface Device) class support.

        config TINYUSB_HID_COUNT
            depends on TINYUSB_HID_ENABLED
            int "Number of HID interfaces"
            default 1
            range 1 4
            help
                Number of HID interfaces (e.g., 2 for keyboard + mouse).

        config TINYUSB_HID_BUFSIZE
            depends on TINYUSB_HID_ENABLED
            int "HID buffer size"
            default 64
            range 8 256
            help
                Size of HID report buffer in bytes.

        config TINYUSB_HID_KEYBOARD_ENABLED
            depends on TINYUSB_HID_ENABLED
            bool "Enable HID Keyboard"
            default n
            help
                Enable HID Keyboard support (Boot Protocol).

        config TINYUSB_HID_MOUSE_ENABLED
            depends on TINYUSB_HID_ENABLED
            bool "Enable HID Mouse"
            default n
            help
                Enable HID Mouse support (Boot Protocol).

    endmenu # HID Device Class

    menu "CDC Device Class"
        depends on TINYUSB && TINYUSB_DEVICE_ENABLED

        config TINYUSB_CDC_ENABLED
            bool "Enable CDC Device Class"
            default n
            help
                Enable USB CDC (Communications Device Class) support.

        config TINYUSB_CDC_COUNT
            depends on TINYUSB_CDC_ENABLED
            int "Number of CDC interfaces"
            default 1
            range 1 3
            help
                Number of CDC serial ports.

        config TINYUSB_CDC_RX_BUFSIZE
            depends on TINYUSB_CDC_ENABLED
            int "CDC RX buffer size"
            default 512
            range 64 4096
            help
                Size of CDC receive buffer in bytes.

        config TINYUSB_CDC_TX_BUFSIZE
            depends on TINYUSB_CDC_ENABLED
            int "CDC TX buffer size"
            default 512
            range 64 4096
            help
                Size of CDC transmit buffer in bytes.

    endmenu # CDC Device Class

    menu "MSC Device Class"
        depends on TINYUSB && TINYUSB_DEVICE_ENABLED

        config TINYUSB_MSC_ENABLED
            bool "Enable MSC Device Class"
            default n
            help
                Enable USB MSC (Mass Storage Class) support.

        config TINYUSB_MSC_COUNT
            depends on TINYUSB_MSC_ENABLED
            int "Number of MSC LUNs"
            default 1
            range 1 4
            help
                Number of Mass Storage Logical Units.

    endmenu # MSC Device Class

    menu "MIDI Device Class"
        depends on TINYUSB && TINYUSB_DEVICE_ENABLED

        config TINYUSB_MIDI_ENABLED
            bool "Enable MIDI Device Class"
            default n
            help
                Enable USB MIDI class support.

    endmenu # MIDI Device Class

    menu "Vendor Device Class"
        depends on TINYUSB && TINYUSB_DEVICE_ENABLED

        config TINYUSB_VENDOR_ENABLED
            bool "Enable Vendor Device Class"
            default n
            help
                Enable USB Vendor-specific class support.

    endmenu # Vendor Device Class

    menu "DFU Runtime Device Class"
        depends on TINYUSB && TINYUSB_DEVICE_ENABLED

        config TINYUSB_DFU_RT_ENABLED
            bool "Enable DFU Runtime Device Class"
            default n
            help
                Enable USB DFU (Device Firmware Update) Runtime support.

    endmenu # DFU Runtime Device Class

endmenu # TinyUSB Stack
```

## src/board/BridgeOne/sdkconfig.defaults
```kconfig
# TinyUSB Configuration (esp_tinyusb wrapper)
# Most settings are handled automatically by esp_tinyusb wrapper
# Only project-specific customizations are included below

# HID interface count (Keyboard + Mouse)
CONFIG_TINYUSB_HID_COUNT=2

# CDC interface (Enable Vendor CDC)
CONFIG_TINYUSB_CDC_ENABLED=y

# UART Optimization (Fast responsiveness)
CONFIG_UART_ISR_IN_IRAM=y

# FreeRTOS Configuration (1ms Tick rate -> 1000Hz, Dual-core enabled)
CONFIG_FREERTOS_HZ=1000
CONFIG_FREERTOS_UNICORE=n

# Memory Optimization (Size priority, PSRAM enabled)
CONFIG_COMPILER_OPTIMIZATION_SIZE=y

# PSRAM Configuration (ESP32-S3-N16R8: 8MB Octal PSRAM)
CONFIG_ESP32S3_SPIRAM_SUPPORT=y
CONFIG_SPIRAM=y
CONFIG_SPIRAM_MODE_OCT=y
CONFIG_SPIRAM_SPEED_80M=y
CONFIG_SPIRAM_USE_MALLOC=y

# Flash Configuration (ESP32-S3-DevkitC-1-N16R8: 16MB Flash)
CONFIG_ESPTOOLPY_FLASHSIZE_16MB=y
CONFIG_ESPTOOLPY_FLASHMODE_QIO=y
CONFIG_ESPTOOLPY_FLASHFREQ_80M=y
CONFIG_PARTITION_TABLE_CUSTOM=y
CONFIG_PARTITION_TABLE_CUSTOM_FILENAME="partitions.csv"

# Logging Level (Development: DEBUG, Production: INFO)
CONFIG_LOG_DEFAULT_LEVEL_DEBUG=y

# TinyUSB Debug Logging
CONFIG_TINYUSB_DEBUG_LEVEL=2

# Disable Unused Peripherals (Power saving)
CONFIG_ESP_WIFI_ENABLED=n
CONFIG_BT_ENABLED=n

# USB Console Configuration
# esp_tinyusb wrapper handles USB PHY switching automatically
# No need to manually disable USB Serial/JTAG
# Console uses UART0 (GPIO43/44, CH343P)
CONFIG_ESP_CONSOLE_UART_DEFAULT=y
```

## src/board/bridgeone_board/sdkconfig.defaults
```kconfig
# TinyUSB Composite 디바이스 설정
CONFIG_TINYUSB=y
CONFIG_TINYUSB_HID_ENABLED=y
CONFIG_TINYUSB_CDC_ENABLED=y
CONFIG_TINYUSB_DEVICE_ENABLED=y

# USB 버스 전원 모드 선택
# (참고: ESP32-S3 DevKit은 USB 버스에서 전원 공급받으므로 BUS_POWERED 권장)
CONFIG_TINYUSB_DEVICE_BUS_POWERED=y

# HID 버퍼 설정 (BridgeOne 8바이트 프레임 처리)
CONFIG_TINYUSB_HID_COUNT=2
CONFIG_TINYUSB_HID_BUFSIZE=64

# CDC 버퍼 설정 (Vendor CDC 메시지 프레임 처리)
CONFIG_TINYUSB_CDC_COUNT=1
CONFIG_TINYUSB_CDC_RX_BUFSIZE=512
CONFIG_TINYUSB_CDC_TX_BUFSIZE=512

# UART 최적화 (빠른 응답성)
CONFIG_UART_ISR_IN_IRAM=y

# FreeRTOS 설정 (1ms Tick rate → 1000Hz, 듀얼 코어 활용)
CONFIG_FREERTOS_HZ=1000
CONFIG_FREERTOS_UNICORE=n

# 메모리 최적화 (크기 우선, PSRAM 활용)
CONFIG_COMPILER_OPTIMIZATION_SIZE=y
CONFIG_SPIRAM=y
CONFIG_SPIRAM_MODE_OCT=y

# 플래시 설정 (ESP32-S3-DevkitC-1-N16R8: 16MB Flash)
CONFIG_ESPTOOLPY_FLASHSIZE_8MB=y
CONFIG_PARTITION_TABLE_CUSTOM=y
CONFIG_PARTITION_TABLE_CUSTOM_FILENAME="partitions.csv"

# 로깅 레벨 설정 (개발: DEBUG, 프로덕션: INFO)
CONFIG_LOG_DEFAULT_LEVEL_INFO=y

# 주변기기 비활성화 (불필요한 전력 소비 방지)
CONFIG_ESP_WIFI_ENABLED=n
CONFIG_BT_ENABLED=n
```
